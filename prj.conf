## CMakeLists.txt
```
# SPDX-License-Identifier: Apache-2.0

cmake_minimum_required(VERSION 3.20.0)

#set_property(GLOBAL APPEND PROPERTY extra_post_build_commands
#  COMMAND foo "hello world"
#  )
find_package(Zephyr REQUIRED HINTS $ENV{ZEPHYR_BASE})
project(zephyr-rgblights)

if(DEFINED CONFIG_APP_USB)
       target_sources(app PRIVATE src/usb_uart.c)
endif()

test_sysbuild()
target_sources(app PRIVATE src/main.c src/led.c src/ble.c src/ble_services/ble_rgbled.c)
target_sources(app PRIVATE ${app_sources})
```

## Kconfig
```
# Copyright (c) 2023 Nordic Semiconductor ASA
# SPDX-License-Identifier: Apache-2.0

config APP_USB
        bool "Enable the application uart over USB"
        default n

config KERNEL_BIN_NAME
    default "zephyr-rgblights"


menu "USB sample options"
	depends on USB_DEVICE_STACK_NEXT

config SAMPLE_USBD_MANUFACTURER
	string "USB device sample manufacturer string"
	default "Zephyr Project"
	help
	  USB device sample manufacturer string.

config SAMPLE_USBD_PRODUCT
	string "USB device sample product string"
	default "USBD sample"
	help
	  USB device sample product stringa.

config SAMPLE_USBD_PID
	hex "USB device sample Product ID"
	default 0x0001
	help
	  USB device sample Product ID.

config SAMPLE_USBD_SELF_POWERED
	bool "USB device sample Self-powered attribute"
	default y
	help
	  Set the Self-powered attribute in the sample configuration.

config SAMPLE_USBD_REMOTE_WAKEUP
	bool "USB device sample Remote Wakeup attribute"
	help
	  Set the Remote Wakeup attribute in the sample configuration.

config SAMPLE_USBD_MAX_POWER
	int "USB device sample bMaxPower value"
	default 125
	range 0 250
	help
	  bMaxPower value in the sample configuration in 2 mA units.

config SAMPLE_USBD_20_EXTENSION_DESC
	bool "Use default USB 2.0 Extension Descriptor"
	help
	  Set bcdUSB value to 0201 and use default USB 2.0 Extension Descriptor.

endmenu

source "Kconfig.zephyr"
```

## prj.conf
```kconfig
# APP
CONFIG_APP_USB=y

# Concole
CONFIG_STDOUT_CONSOLE=y
CONFIG_CONSOLE=y
CONFIG_UART_CONSOLE=y
CONFIG_UART_LINE_CTRL=y
CONFIG_CONSOLE_SUBSYS=y

# WS2812B
CONFIG_LED_STRIP=y
CONFIG_LED_STRIP_LOG_LEVEL_DBG=y

# Bluetooth
CONFIG_BT=y
CONFIG_BT_PERIPHERAL=y
#CONFIG_BT_ZEPHYR_NUS=y
CONFIG_BT_DEVICE_NAME="Led Strip"
# Allow for large Bluetooth data packets.
CONFIG_BT_L2CAP_TX_MTU=498
CONFIG_BT_BUF_ACL_RX_SIZE=502
CONFIG_BT_BUF_ACL_TX_SIZE=502
CONFIG_BT_CTLR_DATA_LENGTH_MAX=251
# Disable Bluetooth ping support
CONFIG_BT_CTLR_LE_PING=n
# Disable Bluetooth PHY update support
CONFIG_BT_USER_PHY_UPDATE=y
#CONFIG_BT_PHY_UPDATE=y
CONFIG_BT_USER_DATA_LEN_UPDATE=y

# Speed up DFU over BT
CONFIG_BT_ATT_PREPARE_COUNT=2
CONFIG_BT_BUF_CMD_TX_SIZE=251
CONFIG_BT_CTLR_PHY_2M=y
CONFIG_BT_CTLR_CONN_RSSI=n
CONFIG_BT_CTLR_PHY_CODED=n
CONFIG_BT_CTLR_TX_PWR_DYNAMIC_CONTROL=y
CONFIG_BT_GATT_ENFORCE_SUBSCRIPTION=n
CONFIG_BT_PERIPHERAL_PREF_TIMEOUT=500



# USB
CONFIG_USB_DEVICE_STACK=y
CONFIG_USB_DEVICE_PRODUCT="Zephyr CDC ACM sample"
CONFIG_USB_DEVICE_PID=0x0001
CONFIG_USB_DEVICE_VID=0x1209
CONFIG_USB_DRIVER_LOG_LEVEL_ERR=y
CONFIG_USB_DEVICE_LOG_LEVEL_ERR=y
CONFIG_SERIAL=y
CONFIG_UART_INTERRUPT_DRIVEN=y
CONFIG_UART_LINE_CTRL=y
CONFIG_USB_DEVICE_INITIALIZE_AT_BOOT=n

# Debug
CONFIG_THREAD_NAME=y
CONFIG_THREAD_RUNTIME_STATS=y
CONFIG_DEBUG_THREAD_INFO=y
CONFIG_SEGGER_DEBUGMON=y
CONFIG_CORTEX_M_DEBUG_MONITOR_HOOK=y
# Enable logging
CONFIG_LOG=y
# Disable debug logging
CONFIG_LOG_MAX_LEVEL=4

# Some command handlers require a large stack.
CONFIG_SYSTEM_WORKQUEUE_STACK_SIZE=2304
CONFIG_MAIN_STACK_SIZE=2048

# Required by the `taskstat` command.
CONFIG_THREAD_MONITOR=y

# Support for taskstat command
CONFIG_MCUMGR_GRP_OS_TASKSTAT=y

# Enable statistics and statistic names.
CONFIG_STATS=y
CONFIG_STATS_NAMES=y

# Enable most core commands.
CONFIG_FLASH=y
CONFIG_IMG_MANAGER=y
CONFIG_MCUMGR_GRP_IMG=y
CONFIG_MCUMGR_GRP_OS=y
CONFIG_MCUMGR_GRP_STAT=y
CONFIG_MCUMGR_GRP_FS=y

# Enable the Bluetooth mcumgr transport (unauthenticated).
CONFIG_MCUMGR_TRANSPORT_BT=y
CONFIG_MCUMGR_TRANSPORT_BT_AUTHEN=n
CONFIG_MCUMGR_TRANSPORT_BT_CONN_PARAM_CONTROL=y
CONFIG_MCUMGR_TRANSPORT_NETBUF_COUNT=6


# Enable the Shell mcumgr transport.
CONFIG_BASE64=y
CONFIG_CRC=y
CONFIG_SHELL=y
CONFIG_SHELL_BACKEND_SERIAL=y
CONFIG_MCUMGR_TRANSPORT_SHELL=y

##########################################
## MCUMGR and DFU related configuration ##
##########################################
# Enable the mcumgr Packet Reassembly feature over Bluetooth and its configuration dependencies.
# MCUmgr buffer size is optimized to fit one SMP packet divided into five Bluetooth Write Commands,
# transmitted with the maximum possible MTU value: 498 bytes.
CONFIG_MCUMGR_TRANSPORT_BT_REASSEMBLY=y
CONFIG_MCUMGR_TRANSPORT_NETBUF_SIZE=2475
CONFIG_MCUMGR_GRP_OS_MCUMGR_PARAMS=y
CONFIG_MCUMGR_TRANSPORT_WORKQUEUE_STACK_SIZE=4608

# Enable the LittleFS file system.
CONFIG_FILE_SYSTEM=y
CONFIG_FILE_SYSTEM_LITTLEFS=y

# Enable file system commands
CONFIG_MCUMGR_GRP_FS=y

# Enable the storage erase command.
CONFIG_MCUMGR_GRP_ZBASIC=y
CONFIG_MCUMGR_GRP_ZBASIC_STORAGE_ERASE=y

# Disable shell commands that are not needed
CONFIG_CLOCK_CONTROL_NRF_SHELL=n
CONFIG_DEVICE_SHELL=n
CONFIG_DEVMEM_SHELL=n
CONFIG_FLASH_SHELL=n

# Enable MCUmgr and dependencies.
CONFIG_NET_BUF=y
CONFIG_ZCBOR=y
CONFIG_MCUMGR=y
CONFIG_STREAM_FLASH=y
CONFIG_FLASH_MAP=y
# Ensure an MCUboot-compatible binary is generated.
CONFIG_BOOTLOADER_MCUBOOT=y
CONFIG_MCUBOOT_UTIL_LOG_LEVEL_WRN=y
CONFIG_MCUBOOT_IMGTOOL_SIGN_VERSION="0.0.0+1"
```

## src/main.c
```c
/*
 * Copyright (c) 2019 Robert Wessels
 *
 * SPDX-License-Identifier: Apache-2.0
 */

#include <zephyr/kernel.h>
#include <zephyr/logging/log.h>
#include <zephyr/stats/stats.h>
#include <zephyr/usb/usb_device.h>

#ifdef CONFIG_MCUMGR_GRP_FS
#include <zephyr/device.h>
#include <zephyr/fs/fs.h>
#include <zephyr/fs/littlefs.h>
#endif
#ifdef CONFIG_MCUMGR_GRP_STAT
#include <zephyr/mgmt/mcumgr/grp/stat_mgmt/stat_mgmt.h>
#endif

LOG_MODULE_REGISTER(bike_light, LOG_LEVEL_INF);

#define STORAGE_PARTITION_LABEL storage_partition
#define STORAGE_PARTITION_ID    FIXED_PARTITION_ID(STORAGE_PARTITION_LABEL)

/* Define an example stats group; approximates seconds since boot. */
STATS_SECT_START(smp_svr_stats)
STATS_SECT_ENTRY(ticks)
STATS_SECT_END;

/* Assign a name to the `ticks` stat. */
STATS_NAME_START(smp_svr_stats)
STATS_NAME(smp_svr_stats, ticks)
STATS_NAME_END(smp_svr_stats);

/* Define an instance of the stats group. */
STATS_SECT_DECL(smp_svr_stats) smp_svr_stats;

#ifdef CONFIG_MCUMGR_GRP_FS
FS_LITTLEFS_DECLARE_DEFAULT_CONFIG(cstorage);
static struct fs_mount_t littlefs_mnt = { .type = FS_LITTLEFS,
                                          .fs_data = &cstorage,
                                          .storage_dev = (void*)STORAGE_PARTITION_ID,
                                          .mnt_point = "/lfs1" };
#endif

int main()
{
    int rc = STATS_INIT_AND_REG(smp_svr_stats, STATS_SIZE_32, "smp_svr_stats");

    if (rc < 0)
    {
        LOG_ERR("Error initializing stats system [%d]", rc);
    }

#ifdef CONFIG_MCUMGR_GRP_FS
    rc = fs_mount(&littlefs_mnt);
    if (rc < 0)
    {
        LOG_ERR("Error mounting littlefs [%d]", rc);
    }
#endif
    /* Register the built-in mcumgr command handlers. */
    /* using __TIME__ ensure that a new binary will be built on every
     * compile which is convenient when testing firmware upgrade.
     */
    LOG_INF("build time: " __DATE__ " " __TIME__);

    /* The system work queue handles all incoming mcumgr requests.  Let the
     * main thread idle while the mcumgr server runs.
     */
    while (1)
    {
        k_sleep(K_MSEC(1000));
        STATS_INC(smp_svr_stats, ticks);
    }
    return 0;
}
```

## src/ble.c
```c
#include <zephyr/kernel.h>
#include <zephyr/sys/printk.h>

#define STACK_SIZE      2048
#define THREAD_PRIORITY 2

/*
 * Copyright (c) 2025 Robert Wessels
 *
 * SPDX-License-Identifier: Apache-2.0
 */

#include "ble_services/ble_rgbled.h"
#include <zephyr/bluetooth/bluetooth.h>
#include <zephyr/bluetooth/services/nus.h>
#include <zephyr/kernel.h>
#include <zephyr/mgmt/mcumgr/transport/smp_bt.h>

#define DEVICE_NAME     CONFIG_BT_DEVICE_NAME
#define DEVICE_NAME_LEN (sizeof(DEVICE_NAME) - 1)

#define SMP_BT_SVC_UUID_VAL BT_UUID_128_ENCODE(0x8d53dc1d, 0x1db7, 0x4cd3, 0x868b, 0x8a527460aa84)
/** SMP service UUID. */
#define SMP_BT_SVC_UUID BT_UUID_DECLARE_128(SMP_BT_SVC_UUID_VAL)
/** SMP characteristic UUID value. */
#define SMP_BT_CHR_UUID_VAL BT_UUID_128_ENCODE(0xda2e7828, 0xfbce, 0x4e01, 0xae9e, 0x261174997c48)

static const struct bt_data ad[] = {
    BT_DATA_BYTES(BT_DATA_FLAGS, (BT_LE_AD_GENERAL | BT_LE_AD_NO_BREDR)),
    BT_DATA_BYTES(BT_DATA_UUID128_ALL, BT_UUID_RGBLED_SERVICE_VAL),
};

#if !defined(CONFIG_BT_EXT_ADV)
static const struct bt_data sd[] = {
    BT_DATA_BYTES(BT_DATA_UUID128_ALL, BT_UUID_RGBLED_SERVICE_VAL),
    // BT_DATA_BYTES(BT_DATA_UUID128_ALL, SMP_BT_SVC_UUID_VAL),
    BT_DATA(BT_DATA_NAME_COMPLETE, CONFIG_BT_DEVICE_NAME, sizeof(CONFIG_BT_DEVICE_NAME) - 1),
};
#endif /* !CONFIG_BT_EXT_ADV */

/* Use atomic variable, 2 bits for connection and disconnection state */
static ATOMIC_DEFINE(state, 2U);

#define STATE_CONNECTED    1U
#define STATE_DISCONNECTED 2U

static void connected(struct bt_conn* conn, uint8_t err)
{
    if (err)
    {
        printk("Connection failed (err 0x%02x)\n", err);
    }
    else
    {
        printk("Connected\n");

        (void)atomic_set_bit(state, STATE_CONNECTED);
    }
}

static void disconnected(struct bt_conn* conn, uint8_t reason)
{
    printk("Disconnected (reason 0x%02x)\n", reason);

    (void)atomic_set_bit(state, STATE_DISCONNECTED);
}

BT_CONN_CB_DEFINE(conn_callbacks) = {
    .connected = connected,
    .disconnected = disconnected,
};

void ble_thread(void)
{
    int err;
    char addr_s[BT_ADDR_LE_STR_LEN];
    bt_addr_le_t addr = { 0 };
    size_t count = 1;

    printk("Sample - Bluetooth Peripheral NUS\n");

    err = bt_enable(NULL);
    if (err)
    {
        printk("Failed to enable bluetooth: %d\n", err);
        return;
    }

    printk("Starting Legacy Advertising (connectable and scannable)\n");
    err = bt_le_adv_start(BT_LE_ADV_CONN_ONE_TIME, ad, ARRAY_SIZE(ad), sd, ARRAY_SIZE(sd));
    if (err)
    {
        printk("Advertising failed to start (err %d)\n", err);
        return;
    }

    // bt_id_get(&addr, &count);
    // bt_addr_le_to_str(&addr, addr_s, sizeof(addr_s));

    // printk("Beacon started, advertising as %s\n", addr_s);

    printk("Initialization complete\n");

    while (true)
    {
        k_sleep(K_SECONDS(3));

        if (atomic_test_and_clear_bit(state, STATE_CONNECTED))
        {
            /* Connected callback executed */
        }
        else if (atomic_test_and_clear_bit(state, STATE_DISCONNECTED))
        {
            printk("Starting Legacy Advertising (connectable and scannable)\n");
            err = bt_le_adv_start(BT_LE_ADV_CONN_ONE_TIME, ad, ARRAY_SIZE(ad), sd, ARRAY_SIZE(sd));
            if (err)
            {
                printk("Advertising failed to start (err %d)\n", err);
                return;
            }
        }
    }

    return;
}

K_THREAD_DEFINE(ble_thread_id, STACK_SIZE, ble_thread, NULL, NULL, NULL, THREAD_PRIORITY, 0, 0);
```

## src/led.c
```c
#include "ble_services/ble_rgbled.h"
#include <zephyr/device.h>
#include <zephyr/drivers/gpio.h>
#include <zephyr/drivers/led_strip.h>
#include <zephyr/kernel.h>
#include <zephyr/logging/log.h>
#include <zephyr/sys/time_units.h>
#include <zephyr/zbus/zbus.h>

LOG_MODULE_REGISTER(led_thread, LOG_LEVEL_DBG);

#define STACK_SIZE 1024
#define PRIORITY   7

#define STRIP_NODE DT_ALIAS(led_strip)

/* Strip Layout
 * [RIGH RUNNER 44] [RIGHT INDICATOR 14] [LEFT INDICATOR 14] [LEFT RUNNER 44]
 */

static uint8_t indicator_state = INDICATOR_OFF;

// Indicators are 23 cm long
#define INDICATOR_RIGHT_NUM_PIXELS 14
#define INDICATOR_LEFT_NUM_PIXELS  14
// Runners are 74 cm long
#define RUNNER_RIGHT_NUM_PIXELS 44
#define RUNNER_LEFT_NUM_PIXELS  44

// #define STRIP_NUM_PIXELS (INDICATOR_RIGHT_NUM_PIXELS + INDICATOR_LEFT_NUM_PIXELS + RUNNER_RIGHT_NUM_PIXELS +
// RUNNER_LEFT_NUM_PIXELS)

#if DT_NODE_HAS_PROP(DT_ALIAS(led_strip), chain_length)
#define STRIP_NUM_PIXELS DT_PROP(DT_ALIAS(led_strip), chain_length)
#else
#error Unable to determine length of LED strip
#endif

#define LED_UPDATE_DELAY 10
#define DELAY_TIME       K_MSEC(LED_UPDATE_DELAY)
#define LED_BLINK_DELAY  500
#define BLINK_DELAY_TIME K_MSEC(LED_BLINK_DELAY)

#define RGB(_r, _g, _b)                 \
    {                                   \
        .r = (_b), .g = (_g), .b = (_r) \
    }

#define HUE_MAX 256

enum
{
    green,
    red,
    blue,
    off,
};

static const struct led_rgb colors[] = {
    RGB(0xff, 0x00, 0x00), /* green */
    RGB(0x00, 0xff, 0x00), /* red */
    RGB(0x00, 0x00, 0xff), /* blue */
    RGB(0x00, 0x00, 0x00), /* off */
};

void rainbow_effect(void);
void off_pattern(void);
void mode_breath(void);
typedef void (*pattern_func_t)(void);

#define NELEMS(x) (sizeof(x) / sizeof((x)[0]))
static const pattern_func_t pattern_table[] = {
    off_pattern,
    rainbow_effect,
    mode_breath,
};

static struct led_rgb pixels[STRIP_NUM_PIXELS];

static const struct device* const strip = DEVICE_DT_GET(STRIP_NODE);

void update_turn_indicators(void)
{
    static bool flash_on = true;
    static int64_t last_toggle_time = 0;
    int64_t current_time = k_uptime_get();

    if (current_time - last_toggle_time >= LED_BLINK_DELAY)
    {
        flash_on = !flash_on;
        last_toggle_time = current_time;
    }

    if (indicator_state == INDICATOR_LEFT)
    {
        for (size_t i = RUNNER_RIGHT_NUM_PIXELS + INDICATOR_RIGHT_NUM_PIXELS;
             i < RUNNER_RIGHT_NUM_PIXELS + INDICATOR_RIGHT_NUM_PIXELS + INDICATOR_LEFT_NUM_PIXELS;
             i++)
        {
            pixels[i] = flash_on ? colors[red] : colors[off]; // Flashing red for left indicator
        }
    }
    else if (indicator_state == INDICATOR_RIGHT)
    {
        for (size_t i = RUNNER_RIGHT_NUM_PIXELS; i < RUNNER_RIGHT_NUM_PIXELS + INDICATOR_RIGHT_NUM_PIXELS; i++)
        {
            pixels[i] = flash_on ? colors[red] : colors[off]; // Flashing red for right indicator
        }
    }
    else if (indicator_state == INDICATOR_HAZARD)
    {
        for (size_t i = RUNNER_RIGHT_NUM_PIXELS; i < RUNNER_RIGHT_NUM_PIXELS + INDICATOR_RIGHT_NUM_PIXELS; i++)
        {
            pixels[i] = flash_on ? colors[red] : colors[off]; // Flashing red for right indicator
        }
        for (size_t i = RUNNER_RIGHT_NUM_PIXELS + INDICATOR_RIGHT_NUM_PIXELS;
             i < RUNNER_RIGHT_NUM_PIXELS + INDICATOR_RIGHT_NUM_PIXELS + INDICATOR_LEFT_NUM_PIXELS;
             i++)
        {
            pixels[i] = flash_on ? colors[red] : colors[off]; // Flashing red for left indicator
        }
    }
}

void off_pattern(void)
{
    memset(pixels, 0, sizeof(pixels));
    update_turn_indicators();
    led_strip_update_rgb(strip, pixels, STRIP_NUM_PIXELS);
    k_sleep(DELAY_TIME);
}

void rainbow_effect(void)
{
    static uint8_t hue = 0;

    for (size_t i = 0; i < STRIP_NUM_PIXELS; i++)
    {
        uint8_t h = (hue + i * HUE_MAX / STRIP_NUM_PIXELS) % 256;
        uint8_t r, g, b;

        if (h < 85)
        {
            r = h * 3;
            g = 255 - h * 3;
            b = 0;
        }
        else if (h < 170)
        {
            h -= 85;
            r = 255 - h * 3;
            g = 0;
            b = h * 3;
        }
        else
        {
            h -= 170;
            r = 0;
            g = h * 3;
            b = 255 - h * 3;
        }

        pixels[i] = (struct led_rgb){ .r = r, .g = g, .b = b };
    }

    update_turn_indicators();
    led_strip_update_rgb(strip, pixels, STRIP_NUM_PIXELS);
    hue += 1;
    k_sleep(DELAY_TIME);
}

void mode_breath(void)
{
    static uint8_t brightness = 0;
    static bool increasing = true;

    if (increasing)
    {
        brightness++;
        if (brightness == 255)
        {
            increasing = false;
        }
    }
    else
    {
        brightness--;
        if (brightness == 0)
        {
            increasing = true;
        }
    }

    for (size_t i = 0; i < STRIP_NUM_PIXELS; i++)
    {
        pixels[i].r = (colors[red].r * brightness) / 255;
        pixels[i].g = (colors[red].g * brightness) / 255;
        pixels[i].b = (colors[red].b * brightness) / 255;
    }

    update_turn_indicators();
    led_strip_update_rgb(strip, pixels, STRIP_NUM_PIXELS);
    k_sleep(DELAY_TIME);
}

void led_thread(void)
{
    uint8_t rgb_pattern = 0, rgb_pattern_prev = 0;

    if (!device_is_ready(strip))
    {
        LOG_ERR("LED strip device %s is not ready", strip->name);
        return;
    }

    LOG_INF("Found LED strip device %s", strip->name);

    /*
     * This will ensure that BLE returns an error if
     * the user sets a pattern num that is beyond the number of available patterns.
     */
    bt_rgbled_service_set_num_patterns(NELEMS(pattern_table));

    while (1)
    {

        indicator_state = bt_rgbled_service_get_indicator();
        rgb_pattern = bt_rgbled_service_get_pattern();
        if (rgb_pattern != rgb_pattern_prev)
        {
            LOG_DBG("RGB pattern %d", rgb_pattern);
            if (rgb_pattern <= ARRAY_SIZE(pattern_table))
            {
                rgb_pattern_prev = rgb_pattern;
            }
        }
        pattern_table[rgb_pattern_prev]();
    }
}

K_THREAD_DEFINE(led_thread_id, STACK_SIZE, led_thread, NULL, NULL, NULL, PRIORITY, 0, 0);
```

## src/usb_uart.c
```c
/*
 * Copyright (c) 2019 Intel Corporation
 *
 * SPDX-License-Identifier: Apache-2.0
 */

/**
 * @file
 * @brief Sample echo app for CDC ACM class
 *
 * Sample app for USB CDC ACM class driver. The received data is echoed back
 * to the serial port.
 */

#include <stdio.h>
#include <string.h>
#include <zephyr/device.h>
#include <zephyr/drivers/gpio.h>
#include <zephyr/drivers/led_strip.h>
#include <zephyr/drivers/spi.h>
#include <zephyr/drivers/uart.h>
#include <zephyr/kernel.h>
#include <zephyr/logging/log.h>
#include <zephyr/sys/ring_buffer.h>
#include <zephyr/sys/util.h>
#include <zephyr/usb/usb_device.h>
#include <zephyr/usb/usbd.h>

#define STACK_SIZE      1024
#define THREAD_PRIORITY 5

LOG_MODULE_REGISTER(cdc_acm_echo, LOG_LEVEL_INF);

#define ZEPHYR_USER_NODE DT_PATH(zephyr_user)

#define RING_BUF_SIZE 1024
uint8_t ring_buffer[RING_BUF_SIZE];

struct ring_buf ringbuf;

static bool rx_throttled;

const struct device* const uart_dev = DEVICE_DT_GET_ONE(zephyr_cdc_acm_uart);

static inline void print_baudrate(const struct device* dev)
{
    uint32_t baudrate;
    int ret;

    ret = uart_line_ctrl_get(dev, UART_LINE_CTRL_BAUD_RATE, &baudrate);
    if (ret)
    {
        LOG_WRN("Failed to get baudrate, ret code %d", ret);
    }
    else
    {
        LOG_INF("Baudrate %u", baudrate);
    }
}

static void interrupt_handler(const struct device* dev, void* user_data)
{
    ARG_UNUSED(user_data);

    while (uart_irq_update(dev) && uart_irq_is_pending(dev))
    {
        if (!rx_throttled && uart_irq_rx_ready(dev))
        {
            int recv_len, rb_len;
            uint8_t buffer[64];
            size_t len = MIN(ring_buf_space_get(&ringbuf), sizeof(buffer));

            if (len == 0)
            {
                /* Throttle because ring buffer is full */
                uart_irq_rx_disable(dev);
                rx_throttled = true;
                continue;
            }

            recv_len = uart_fifo_read(dev, buffer, len);
            if (recv_len < 0)
            {
                LOG_ERR("Failed to read UART FIFO");
                recv_len = 0;
            };

            rb_len = ring_buf_put(&ringbuf, buffer, recv_len);
            if (rb_len < recv_len)
            {
                LOG_ERR("Drop %u bytes", recv_len - rb_len);
            }

            LOG_DBG("tty fifo -> ringbuf %d bytes", rb_len);
            if (rb_len)
            {
                uart_irq_tx_enable(dev);
            }
        }

        if (uart_irq_tx_ready(dev))
        {
            uint8_t buffer[64];
            int rb_len, send_len;

            rb_len = ring_buf_get(&ringbuf, buffer, sizeof(buffer));
            if (!rb_len)
            {
                LOG_DBG("Ring buffer empty, disable TX IRQ");
                uart_irq_tx_disable(dev);
                continue;
            }

            if (rx_throttled)
            {
                uart_irq_rx_enable(dev);
                rx_throttled = false;
            }

            send_len = uart_fifo_fill(dev, buffer, rb_len);
            if (send_len < rb_len)
            {
                LOG_ERR("Drop %d bytes", rb_len - send_len);
            }

            LOG_DBG("ringbuf -> tty fifo %d bytes", send_len);
        }
    }
}

int uart_thread(void)
{
    int ret;

    if (!device_is_ready(uart_dev))
    {
        LOG_ERR("CDC ACM device not ready");
        return 0;
    }

    ret = usb_enable(NULL);

    if (ret != 0)
    {
        LOG_ERR("Failed to enable USB");
        return 0;
    }

    ring_buf_init(&ringbuf, sizeof(ring_buffer), ring_buffer);

    LOG_INF("Wait for DTR");

    while (true)
    {
        uint32_t dtr = 0U;

        uart_line_ctrl_get(uart_dev, UART_LINE_CTRL_DTR, &dtr);
        if (dtr)
        {
            break;
        }
        else
        {
            /* Give CPU resources to low priority threads. */
            k_sleep(K_MSEC(100));
        }
    }

    LOG_INF("DTR set");

    /* They are optional, we use them to test the interrupt endpoint */
    ret = uart_line_ctrl_set(uart_dev, UART_LINE_CTRL_DCD, 1);
    if (ret)
    {
        LOG_WRN("Failed to set DCD, ret code %d", ret);
    }

    ret = uart_line_ctrl_set(uart_dev, UART_LINE_CTRL_DSR, 1);
    if (ret)
    {
        LOG_WRN("Failed to set DSR, ret code %d", ret);
    }

    /* Wait 100ms for the host to do all settings */
    k_msleep(100);

    print_baudrate(uart_dev);

    uart_irq_callback_set(uart_dev, interrupt_handler);

    /* Enable rx interrupts */
    uart_irq_rx_enable(uart_dev);

    return 0;
}

K_THREAD_DEFINE(uart_thread_id, STACK_SIZE, uart_thread, NULL, NULL, NULL, THREAD_PRIORITY, 0, 0);
```
